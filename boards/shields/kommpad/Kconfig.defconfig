## config/boards/shields/kommpad/Kconfig.defconfig
```kconfig
if SHIELD_KOMMPAD

config ZMK_KEYBOARD_NAME
    default "KommPad"

if ZMK_DISPLAY

config I2C
    default y

config SSD1306
    default y

endif # ZMK_DISPLAY

endif
```
